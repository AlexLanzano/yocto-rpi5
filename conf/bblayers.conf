## conf/bblayers.conf
```bitbake
# LAYER_CONF_VERSION is increased each time build/conf/bblayers.conf
# changes incompatibly
LCONF_VERSION = "7"

BBPATH = "${TOPDIR}:${TOPDIR}/layers/openembedded-core:${TOPDIR}/layers/meta-raspberrypi"
#BBPATH += "${TOPDIR}/openembedded/openembedded-core"
BBFILES ?= ""

BBLAYERS ?= " \
  ${TOPDIR}/layers/openembedded-core/meta \
  ${TOPDIR}/layers/meta-raspberrypi \
  ${TOPDIR}/layers/meta-raspberrypi-dev \
  "
```

## conf/local.conf
```bitbake
MACHINE = "raspberrypi5"
ENABLE_UART = "1"
ENABLE_UART0_CONSOLE = "1"
SERIAL_CONSOLES = "115200;ttyAMA0"
```
